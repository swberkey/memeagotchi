## hardware/ember-vale/esp-idf/components/ember_vale/Kconfig
```kconfig
menu "Ember Vale (adventure addon)"

    menu "LCD (ST7789 / ST7789V2, SPI)"
        config EV_LCD_SPI_HOST
            int "SPI host (2 = SPI2/FSPI, 3 = SPI3)"
            range 2 3
            default 2
        config EV_PIN_SCLK
            int "SCLK GPIO"
            default 12
        config EV_PIN_MOSI
            int "MOSI (SDA) GPIO"
            default 11
        config EV_PIN_CS
            int "CS GPIO (-1 if tied low)"
            default 10
        config EV_PIN_DC
            int "DC (RS) GPIO"
            default 9
        config EV_PIN_RST
            int "RESET GPIO (-1 if not wired)"
            default 14
        config EV_PIN_BL
            int "Backlight GPIO (-1 if always on)"
            default 13
        config EV_BL_ON_LEVEL
            int "Backlight on level"
            range 0 1
            default 1
        config EV_LCD_PCLK_MHZ
            int "SPI clock in MHz (40 safe, 80 if the wiring is short)"
            range 10 80
            default 40
        config EV_LCD_INVERT
            bool "Invert colours (most ST7789V2 modules need this)"
            default y
        config EV_LCD_BGR
            bool "Panel is BGR"
            default n
        config EV_LCD_SWAP_XY
            bool "Swap X/Y (landscape on a 240x320 panel)"
            default y
        config EV_LCD_MIRROR_X
            bool "Mirror X"
            default y
        config EV_LCD_MIRROR_Y
            bool "Mirror Y"
            default n
        config EV_LCD_X_GAP
            int "X offset (gap) in pixels"
            default 0
        config EV_LCD_Y_GAP
            int "Y offset (gap) in pixels"
            default 0
        config EV_BAND_LINES
            int "Lines per DMA band (2 bands in internal RAM)"
            range 8 120
            default 40
    endmenu

    menu "Buttons (active low, internal pull-up)"
        config EV_PIN_UP
            int "D-pad up GPIO (-1 = not used)"
            default 4
        config EV_PIN_DOWN
            int "D-pad down GPIO"
            default 5
        config EV_PIN_LEFT
            int "D-pad left GPIO"
            default 6
        config EV_PIN_RIGHT
            int "D-pad right GPIO"
            default 7
        config EV_PIN_X
            int "X button GPIO (sword / talk)"
            default 15
        config EV_PIN_O
            int "O button GPIO (use item)"
            default 16
        config EV_PIN_START
            int "Menu/Start button GPIO"
            default 17
    endmenu

    config EV_SAVE_DIR
        string "Default save folder (already mounted by the host)"
        default "/storage/adventure"

endmenu
```
